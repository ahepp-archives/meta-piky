## conf/layer.conf
```bitbake
# We have a conf and classes directory, add to BBPATH
BBPATH .= ":${LAYERDIR}"

# We have recipes-* directories, add to BBFILES
BBFILES += "${LAYERDIR}/recipes-*/*/*.bb \
            ${LAYERDIR}/recipes-*/*/*.bbappend"

BBFILE_COLLECTIONS += "meta-piky"
BBFILE_PATTERN_meta-piky = "^${LAYERDIR}/"
BBFILE_PRIORITY_meta-piky = "10"

LAYERDEPENDS_meta-piky = "core"
LAYERSERIES_COMPAT_meta-piky = "dunfell"
```

## conf/machine/raspberrypi0-wifi.conf
```bitbake
MACHINE_EXTRA_ESSENTIAL_RDEPENDS += "linux-firmware-bcm43430"
MACHINE_FEATURES += "wifi"
```
